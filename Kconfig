## kconfig/Kconfig.analysis
```kconfig
# SPDX-License-Identifier: MIT

menu "Analysis"

config WITH_COMPILER_WARNINGS
	bool "Compiler warnings"
	default y
	cmake
	help
	  Enable common compiler warnings.

config WITH_CPPCHECK
	bool "Cppcheck"
	default y
	cmake
	help
	  Enable cppcheck analysis for library sources.

config WITH_CPPCHECK_MISRA
	bool "Cppcheck MISRA"
	default y
	depends on WITH_CPPCHECK
	cmake
	help
	  Enable the cppcheck MISRA C:2012 addon.

config WITH_CPPCHECK_WARNINGS_AS_ERRORS
	bool "Cppcheck errors"
	default y
	depends on WITH_CPPCHECK
	cmake
	help
	  Fail the build when cppcheck reports findings.

config CPPCHECK_MISRA_RULE_TEXTS
	string "MISRA rule texts"
	default ""
	depends on WITH_CPPCHECK && WITH_CPPCHECK_MISRA
	cmake
	help
	  Optional licensed MISRA rule-headlines file.

config CPPCHECK_MAX_CTU_DEPTH
	int "Cppcheck CTU depth"
	default "4"
	minimum 1
	depends on WITH_CPPCHECK
	help
	  Maximum CTU depth for cppcheck-report.

endmenu
```

## kconfig/Kconfig.build
```kconfig
# SPDX-License-Identifier: MIT

menu "Build"

config TOOLCHAIN
	enum "Toolchain"
	values "llvm" "gnu" "aarch64-none-linux-llvm" "aarch64-none-linux-gnu"
	default "llvm"
	help
	  Compiler toolchain and matching CMake toolchain file.

config BUILD_TYPE
	enum "Build type"
	values "Debug" "Release" "RelWithDebInfo" "MinSizeRel"
	default "Release"
	help
	  CMake optimization and debug-information profile.

config WITH_AUTO_VECTORIZATION
	bool "Compiler auto-vectorization"
	default y
	cmake
	help
	  Allow the compiler to vectorize scalar loops automatically. Disabling
	  this option does not disable explicitly selected SIMD or NEON sources.

config NPROC
	int "Parallel jobs"
	default "${CPU_COUNT}"
	minimum 1
	help
	  Maximum number of parallel build jobs.

config V
	enum "Verbose build"
	values "0" "1"
	default "0"
	help
	  Print verbose compiler and linker commands.

config INSTALL_PREFIX
	string "Install prefix"
	default ""
	cmake CMAKE_INSTALL_PREFIX
	help
	  Optional installation prefix; empty uses the build-tree default.

endmenu
```

## kconfig/Kconfig.features
```kconfig
# SPDX-License-Identifier: MIT

menu "Features"

config WITH_TEST_APP
	bool "Test applications"
	default y
	cmake
	help
	  Build the applications and CTest entries under test/.

config WITH_BENCHMARK_COMPARE
	bool "Benchmark comparison"
	default y
	depends on WITH_TEST_APP
	cmake
	help
	  Build Cairo and available NE10 resize comparison backends.

config WITH_SIMD
	bool "SIMD"
	default y
	cmake
	help
	  Enable architecture-specific SIMD detection and sources.

config WITH_THREAD
	bool "Thread support"
	default y
	cmake
	help
	  Enable the platform thread backend and threadpool.

endmenu
```

## kconfig/Kconfig.profiling
```kconfig
# SPDX-License-Identifier: MIT

menu "Profiling"

config WITH_LTTNG
	bool "LTTng profiling"
	default n
	cmake
	help
	  Enable Linux LTTng-UST trace instrumentation.

config LTTNG_UST_ROOT
	string "LTTng-UST root"
	default ""
	depends on WITH_LTTNG
	cmake
	help
	  Optional non-system LTTng-UST installation prefix.

endmenu
```

## kconfig/Kconfig.runtime
```kconfig
# SPDX-License-Identifier: MIT

menu "Runtime"

config WITH_RUNTIME_TEST
	bool "Runtime-test preset"
	default n
	select WITH_TEST_APP
	select WITH_SANITIZER
	select WITH_STACK_PROTECTOR
	set BUILD_TYPE "Debug"
	set STACK_PROTECTOR_MODE "all"
	set SGL_TEST_CROP_REPEAT_COUNT "1"
	set SGL_TEST_CROP_WARMUP_COUNT "0"
	set SGL_TEST_CONVERT_REPEAT_COUNT "1"
	set SGL_TEST_CONVERT_WARMUP_COUNT "0"
	set SGL_TEST_ROTATE_REPEAT_COUNT "1"
	set SGL_TEST_ROTATE_WARMUP_COUNT "0"
	set SGL_TEST_RESIZE_REPEAT_COUNT "1"
	set SGL_TEST_RESIZE_WARMUP_COUNT "0"
	help
	  Enable the Debug sanitizer and stack-protector preset.

config WITH_SANITIZER
	bool "Sanitizer"
	default n
	cmake
	help
	  Enable compiler sanitizer instrumentation.

config SANITIZERS
	string "Sanitizer list"
	default "address,undefined"
	depends on WITH_SANITIZER
	cmake
	help
	  Comma-separated sanitizers; thread requires a separate build.

config WITH_STACK_PROTECTOR
	bool "Stack protector"
	default n
	cmake
	help
	  Enable compiler stack-protector instrumentation.

config STACK_PROTECTOR_MODE
	enum "Stack protector mode"
	values "basic" "strong" "all"
	default "strong"
	depends on WITH_STACK_PROTECTOR
	cmake
	help
	  Stack-protector coverage level.

endmenu
```

## kconfig/Kconfig.tests
```kconfig
# SPDX-License-Identifier: MIT

menu "Tests"

config SGL_TEST_CROP_REPEAT_COUNT
	int "Crop repeats"
	default "10"
	minimum 1
	depends on WITH_TEST_APP
	cmake
	help
	  Measured crop benchmark iterations.

config SGL_TEST_CROP_WARMUP_COUNT
	int "Crop warm-ups"
	default "3"
	minimum 0
	depends on WITH_TEST_APP
	cmake
	help
	  Untimed crop benchmark warm-up iterations.

config SGL_TEST_CONVERT_REPEAT_COUNT
	int "Convert repeats"
	default "10"
	minimum 1
	depends on WITH_TEST_APP
	cmake
	help
	  Measured convert benchmark iterations.

config SGL_TEST_CONVERT_WARMUP_COUNT
	int "Convert warm-ups"
	default "3"
	minimum 0
	depends on WITH_TEST_APP
	cmake
	help
	  Untimed convert benchmark warm-up iterations.

config SGL_TEST_CONVERT_MATRIX_WIDTH
	int "Convert image width"
	default "1280"
	minimum 2
	depends on WITH_TEST_APP
	cmake
	help
	  Width used by the convert benchmark and complete FourCC matrix.

config SGL_TEST_CONVERT_MATRIX_HEIGHT
	int "Convert image height"
	default "720"
	minimum 2
	depends on WITH_TEST_APP
	cmake
	help
	  Height used by the convert benchmark and complete FourCC matrix.

config SGL_TEST_ROTATE_REPEAT_COUNT
	int "Rotate repeats"
	default "10"
	minimum 1
	depends on WITH_TEST_APP
	cmake
	help
	  Measured rotate benchmark iterations.

config SGL_TEST_ROTATE_WARMUP_COUNT
	int "Rotate warm-ups"
	default "3"
	minimum 0
	depends on WITH_TEST_APP
	cmake
	help
	  Untimed rotate benchmark warm-up iterations.

config SGL_TEST_RESIZE_REPEAT_COUNT
	int "Resize repeats"
	default "10"
	minimum 1
	depends on WITH_TEST_APP
	cmake
	help
	  Measured resize benchmark iterations.

config SGL_TEST_RESIZE_WARMUP_COUNT
	int "Resize warm-ups"
	default "3"
	minimum 0
	depends on WITH_TEST_APP
	cmake
	help
	  Untimed resize benchmark warm-up iterations.

endmenu
```
